#include "JM_ssd1306.h"
#include "driver/i2c.h"

using namespace std;

// OLED 6*8字库
unsigned char F6x8[][6] = {
    {0x00, 0x00, 0x00, 0x00, 0x00, 0x00}, // sp
    {0x00, 0x00, 0x00, 0x2f, 0x00, 0x00}, // !
    {0x00, 0x00, 0x07, 0x00, 0x07, 0x00}, // "
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    {0x14, 0x14, 0x14, 0x14, 0x14, 0x14}, // horiz lines
};

// OLED 8*16字库
unsigned char F8X16[] = {
    0x00, 0x00, 0x00, 0x00, 0x00, 0x00, 0x00, 0x00, 0x00, 0x00, 0x00, 0x00, 0x00, 0x00, 0x00, 0x00, // 0  每一列有16個8位元資料
    0x00, 0x00, 0x00, 0xF8, 0x00, 0x00, 0x00, 0x00, 0x00, 0x00, 0x00, 0x33, 0x30, 0x00, 0x00, 0x00, //! 1
    0x00, 0x10, 0x0C, 0x06, 0x10, 0x0C, 0x06, 0x00, 0x00, 0x00, 0x00, 0x00, 0x00, 0x00, 0x00, 0x00, //" 2
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    0x00, 0x06, 0x01, 0x01, 0x02, 0x02, 0x04, 0x04, 0x00, 0x00, 0x00, 0x00, 0x00, 0x00, 0x00, 0x00, //~ 94
};

// OLED 中文字库
unsigned char Hzk[][32] = {

    {0x00, 0x00, 0x08, 0x00, 0x09, 0x00, 0x19, 0x00, 0x11, 0xfe, 0x32, 0x06, 0x32, 0x24, 0x50, 0x20, },
    {0x11, 0x2c, 0x11, 0x24, 0x11, 0x24, 0x12, 0x26, 0x12, 0x26, 0x10, 0x20, 0x10, 0xe0, 0x10, 0x80  },                 /*"陀", 0*/

    {0x10,0x21,0x62,0x06,0x80,0xfc,0x11,0xd6,0x50,0xfa,0x52,0xda,0x12,0xff,0x02,0x00},
    {0x04,0x04,0xfe,0x01,0x00,0xff,0x20,0x17,0x0d,0x7f,0x0d,0x17,0xa0,0xff,0x00,0x00},                  /*"羅",1*/

    {0x40,0x42,0x44,0xcc,0x00,0x00,0x38,0xc0,0x02,0x0c,0x00,0x80,0x60,0x1c,0x00,0x00},
    {0x00,0x00,0x00,0x3f,0x90,0x48,0x20,0x10,0x0b,0x04,0x0a,0x11,0x60,0xc0,0x40,0x00}    /*"計",2*/
};

unsigned char backgroung[] = {

    0x00, 0x00, 0x00, 0x00, 0x00, 0x00, 0x00, 0x00, 0x00, 0x00, 0x00, 0x00, 0x00, 0x00, 0x00, 0x00, 
    0x00, 0x00, 0x00, 0x00, 0x00, 0x00, 0x00, 0x00, 0x00, 0x00, 0x00, 0x00, 0x00, 0x00, 0x00, 0x00, 
    0x00, 0x00, 0x00, 0x00, 0x00, 0x00, 0x00, 0x00, 0x00, 0x00, 0x00, 0x00, 0x00, 0x00, 0x00, 0x00, 
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    0x00, 0x00, 0x00, 0x00, 0x00, 0x00, 0x00, 0x00, 0x00, 0x00, 0x00, 0x00, 0x00, 0x00, 0x00, 0x00

};





JM_ssd1306::JM_ssd1306(uint8_t ssd1306_slave_addr){

    SSD1306_SLAVE_ADDR = ssd1306_slave_addr;

}

esp_err_t JM_ssd1306::OLED_WR_Byte(uint8_t data, uint8_t cmd_){

    int ret;
    uint8_t cam_data = (cmd_ == 1) ? (uint8_t)(0x40) : (uint8_t)(0x00);    //0x40 write data GGDRAM ， 0x00 command data to command register
    i2c_cmd_handle_t cmd = i2c_cmd_link_create();
    i2c_master_start(cmd);
    i2c_master_write_byte(cmd, SSD1306_SLAVE_ADDR << 1 | I2C_MASTER_WRITE, true);
    i2c_master_write_byte(cmd, cam_data, true);
    i2c_master_write_byte(cmd, data, true);
    i2c_master_stop(cmd);
    ret = i2c_master_cmd_begin(I2C_NUM_0, cmd, I2C_MASTER_TIMEOUT_MS / portTICK_PERIOD_MS);

    i2c_cmd_link_delete(cmd);
    return ret;

}

void JM_ssd1306::OLED_Set_Pos(uint8_t x, uint8_t y)
{
    OLED_WR_Byte(0xb0 + y, CMD_MODE);
    OLED_WR_Byte(((x & 0xf0) >> 4) | 0x10, CMD_MODE);
    OLED_WR_Byte((x & 0x0f), CMD_MODE);
}


void JM_ssd1306::OLED_Clear(void){

    uint8_t i, n;
    for (i = 0; i < 8; i++)
    {
        OLED_WR_Byte(0xb0 + i, CMD_MODE);
        OLED_WR_Byte(0x00, CMD_MODE);
        OLED_WR_Byte(0x10, CMD_MODE);
        for (n = 0; n < 128; n++)
            OLED_WR_Byte(0, DATA_MODE);
    }

}

void JM_ssd1306::OLED_ShowChar(uint8_t x, uint8_t y, uint8_t chr, uint8_t Char_Size)
{
    uint8_t c = 0;
    uint8_t i = 0;
    c = chr - ' ';
    if (x > 127)
    {
        x = x % 128;
        y = y + 2;
    }
    if (Char_Size == FONT_SIZE_F8X16)
    {
        OLED_Set_Pos(x, y);
        for (i = 0; i < 8; i++)
            OLED_WR_Byte(F8X16[c * 16 + i], DATA_MODE);
        OLED_Set_Pos(x, y + 1);
        for (i = 0; i < 8; i++)
            OLED_WR_Byte(F8X16[c * 16 + i + 8], DATA_MODE);
    }
    else     //FONT_SIZE_F6x8
    {
        OLED_Set_Pos(x, y);
        for (i = 0; i < 6; i++)
            OLED_WR_Byte(F6x8[c][i], DATA_MODE);
    }
}

void JM_ssd1306::oled_print(uint8_t start_x, uint8_t start_y, const char* display_data, uint8_t font_size){

    const char* current_char = display_data; 
    uint8_t draw_x = start_x;
    uint8_t i = 0;
    while(*(display_data) != '\0'){

        if(font_size == FONT_SIZE_F6x8 ){
            draw_x += i + 6;
        }
        else if (font_size == FONT_SIZE_F8X16)
        {
            draw_x += i + 8;
        }

        OLED_ShowChar(draw_x, start_y, *(display_data), 0);
        (display_data)++;
        i++;
    }
}

uint8_t test_image[] = {
    0x06, 0x0a, 0x32, 0x32, 0x0a, 0x06
};

void JM_ssd1306::oled_draw_xaxis(uint8_t x, uint8_t y){
    
    for(int i = 0; i < 128; i++){

        OLED_Set_Pos(x + i, y);
        OLED_WR_Byte(0x08, DATA_MODE);

    }
    
    
}

void JM_ssd1306::oled_draw_yaxis(uint8_t x, uint8_t y){
    
    for(int i = 0; i < 7; i++){

        OLED_Set_Pos(x, y + i);
        OLED_WR_Byte(0xff, DATA_MODE);

    }
    
    
}


void JM_ssd1306::OLED_Init(void){

    OLED_WR_Byte(0xAE, CMD_MODE); //--display off
    OLED_WR_Byte(0xd5, CMD_MODE); 
    OLED_WR_Byte(0x80, CMD_MODE); 
    OLED_WR_Byte(0xa8, CMD_MODE); 
    OLED_WR_Byte(0x3f, CMD_MODE); 
    OLED_WR_Byte(0xd3, CMD_MODE); 
    OLED_WR_Byte(0x00, CMD_MODE); 
    OLED_WR_Byte(0x40, CMD_MODE); 
    OLED_WR_Byte(0x8d, CMD_MODE); 
    OLED_WR_Byte(0x14, CMD_MODE); 
    OLED_WR_Byte(0x20, CMD_MODE); 
    OLED_WR_Byte(0x00, CMD_MODE); 
    OLED_WR_Byte(0xa1, CMD_MODE); 
    OLED_WR_Byte(0xc8, CMD_MODE); 
    OLED_WR_Byte(0xDa, CMD_MODE); 
    OLED_WR_Byte(0x12, CMD_MODE); 
    OLED_WR_Byte(0x81, CMD_MODE);   //調整oled顯示對比度 0-255
    OLED_WR_Byte(0xef, CMD_MODE); 
    OLED_WR_Byte(0xD9, CMD_MODE); 
    OLED_WR_Byte(0xF1, CMD_MODE); 
    OLED_WR_Byte(0xDb, CMD_MODE); 
    OLED_WR_Byte(0x40, CMD_MODE); 
    OLED_WR_Byte(0xAF, CMD_MODE); 
    OLED_Clear();

}
